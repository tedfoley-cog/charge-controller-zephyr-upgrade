## boards/libresolar/mppt_1210_hus/board.yml
```yaml
board:
  name: mppt_1210_hus
  full_name: Libre Solar MPPT 1210 HUS
  vendor: libresolar
  revision:
    format: major.minor.patch
    default: "0.7.1"
    exact: false
    revisions:
      - name: "0.4.0"
      - name: "0.7.0"
      - name: "0.7.1"
  socs:
    - name: stm32l072xx
```

## boards/libresolar/pwm_2420_lus/board.yml
```yaml
board:
  name: pwm_2420_lus
  full_name: Libre Solar PWM 2420 LUS
  vendor: libresolar
  revision:
    format: major.minor.patch
    default: "0.3.0"
    revisions:
      - name: "0.2.0"
      - name: "0.3.0"
  socs:
    - name: stm32l072xx
```
